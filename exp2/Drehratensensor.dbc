VERSION ""

NS_ :

BS_:

BU_:

BO_ 512 Drehratennachrig_2: 8 Vector__XXX
 SG_ Querbeschleunigung_in_X_Richtung : 32|16@1+ (0.000127465,-4.1768) [-4.1768|4.176618775] "g" Vector__XXX
 SG_ Drehbeschleunigung : 0|16@1+ (0.125,-4096) [-4096|4095.875] "°/s^2" Vector__XXX

BO_ 256 Drehratennachrig_1: 8 Vector__XXX
 SG_ Querbeschleunigung_in_Y_Richtung : 32|16@1+ (0.000127465,-4.1768) [-4.1768|4.176618775] "g" Vector__XXX
 SG_ Drehgeschwindigkeit : 0|16@1+ (0.005,-163.84) [-163.84|163.835] "°/s" Vector__XXX

BA_DEF_  "BusType" STRING ;
BA_DEF_DEF_  "BusType" "";
BA_ "BusType" "CAN";
